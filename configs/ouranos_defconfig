## configs/ouranos_defconfig
```kconfig
BR2_x86_64=y
BR2_x86_corei7=y
BR2_DEFCONFIG="$(CONFIG_DIR)/configs/ouranos_defconfig"
BR2_DL_DIR="$(HOME)/buildroot/dl"
BR2_CCACHE=y
BR2_CCACHE_DIR="$(HOME)/buildroot/ccache"
BR2_ENABLE_SSP=y
BR2_TOOLCHAIN_BUILDROOT_GLIBC=y
BR2_GLIBC_VERSION_2_21=y
BR2_BINUTILS_VERSION_2_25_X=y
BR2_GCC_VERSION_5_X=y
BR2_ENABLE_LOCALE_PURGE=y
BR2_ENABLE_LOCALE_WHITELIST="C en_US"
BR2_GENERATE_LOCALE="en_US"
BR2_TARGET_GENERIC_HOSTNAME="ouranos"
BR2_TARGET_GENERIC_ISSUE="Welcome to Ouranos"
BR2_TARGET_GENERIC_PASSWD_SHA512=y
BR2_INIT_SYSTEMD=y
# BR2_TARGET_GENERIC_GETTY is not set
BR2_ROOTFS_OVERLAY="$(CONFIG_DIR)/board/ouranos/overlay"
BR2_ROOTFS_POST_BUILD_SCRIPT="$(CONFIG_DIR)/board/ouranos/post_build.sh"
BR2_ROOTFS_POST_IMAGE_SCRIPT="$(CONFIG_DIR)/board/ouranos/post_image.sh"
BR2_LINUX_KERNEL=y
BR2_LINUX_KERNEL_CUSTOM_VERSION=y
BR2_LINUX_KERNEL_CUSTOM_VERSION_VALUE="4.1.6"
BR2_LINUX_KERNEL_USE_CUSTOM_CONFIG=y
BR2_LINUX_KERNEL_CUSTOM_CONFIG_FILE="$(CONFIG_DIR)/board/ouranos/linux.config"
BR2_LINUX_KERNEL_INSTALL_TARGET=y
BR2_PACKAGE_BUSYBOX_CONFIG="$(CONFIG_DIR)/board/ouranos/busybox.config"
BR2_PACKAGE_DROPBEAR=y
BR2_PACKAGE_DROPBEAR_DISABLE_REVERSEDNS=y
BR2_PACKAGE_SYSTEMD_NETWORKD=y
BR2_PACKAGE_SYSTEMD_TIMESYNCD=y
BR2_PACKAGE_LESS=y
BR2_TARGET_ROOTFS_EXT2=y
BR2_TARGET_ROOTFS_EXT2_4=y
BR2_TARGET_ROOTFS_EXT2_LABEL="ROOT"
# BR2_TARGET_ROOTFS_TAR is not set
BR2_TARGET_SYSLINUX=y
BR2_TARGET_SYSLINUX_MBR=y
BR2_TARGET_SYSLINUX_C32="menu.c32 libutil.c32"
```
